/*
 * camera.c
 *
 *  Created on: Dec 7, 2025
 *      Author: Archer Date
 *      See resources used in camera.h
 */

#include "camera.h"

// set up buffer
uint8_t camera_buf[rgb888_data_length];

// this register table sets up YCbCr output, from application notes
const struct sensor_reg OV5642_QVGA_Preview[] = {
    {0x3103, 0x93}, {0x3008, 0x82}, {0x3017, 0x7f}, {0x3018, 0xfc},
    {0x3810, 0xc2}, {0x3615, 0xf0}, {0x3000, 0x00}, {0x3001, 0x00},
    {0x3002, 0x5c}, {0x3003, 0x00}, {0x3004, 0xff}, {0x3005, 0xff},
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    {0xffff, 0xff},
};

// most of these functions are from arduino and stm32 example driver
// repositories
void CS_HIGH(void) { HAL_GPIO_WritePin(CS_PORT, CS_PIN, GPIO_PIN_SET); }

void CS_LOW(void) { HAL_GPIO_WritePin(CS_PORT, CS_PIN, GPIO_PIN_RESET); }

uint8_t bus_read(uint8_t addr) {
  uint8_t taddr = addr & 0x7F;
  uint8_t data = 0;
  uint8_t dummy = 0;

  CS_LOW();
  HAL_SPI_Transmit(&hspi1, &taddr, 1, HAL_MAX_DELAY);
  HAL_SPI_TransmitReceive(&hspi1, &dummy, &data, 1, HAL_MAX_DELAY);
  CS_HIGH();

  return data;
}

void bus_write(uint8_t addr, uint8_t data) {
  uint8_t taddr = addr | 0x80;
  CS_LOW();
  HAL_SPI_Transmit(&hspi1, &taddr, 1, HAL_MAX_DELAY);
  HAL_SPI_Transmit(&hspi1, &data, 1, HAL_MAX_DELAY);
  CS_HIGH();
}

// all registers are 16 bit addresses
// example codes bit bang i2c- this is replaced by HAL
void wrSensorReg16_8(uint16_t regID, uint8_t regDat) {
  HAL_I2C_Mem_Write(&hi2c4, OV5642_I2C_ADDR, regID, I2C_MEMADD_SIZE_16BIT,
                    &regDat, 1, HAL_MAX_DELAY);
}

void rdSensorReg16_8(uint16_t regID, uint8_t *regDat) {
  HAL_I2C_Mem_Read(&hi2c4, OV5642_I2C_ADDR, regID, I2C_MEMADD_SIZE_16BIT,
                   regDat, 1, HAL_MAX_DELAY);
}

void wrSensorRegs16_8(const struct sensor_reg *regs) {

  uint16_t reg_addr = regs->reg;
  uint8_t reg_val = regs->val;

  while ((reg_addr != 0xffff) || (reg_val != 0xff)) {
    HAL_I2C_Mem_Write(&hi2c4, OV5642_I2C_ADDR, reg_addr, I2C_MEMADD_SIZE_16BIT,
                      &reg_val, 1, HAL_MAX_DELAY);
    HAL_Delay(1);
    regs++;
    reg_addr = regs->reg;
    reg_val = regs->val;
  }
}

uint8_t get_bit(uint8_t addr, uint8_t bit) {
  uint8_t temp = bus_read(addr);
  return temp & bit;
}

uint8_t read_fifo(void) {
  uint8_t data;
  data = bus_read(SINGLE_FIFO_READ);
  return data;
}

// puts into burst mode
void set_fifo_burst(void) {
  uint8_t data = BURST_FIFO_READ; // 0x3C
  HAL_SPI_Transmit(&hspi1, &data, 1, HAL_MAX_DELAY);
}

void flush_fifo(void) {
  bus_write(ARDUCHIP_FIFO, FIFO_CLEAR_MASK); // write_reg funct --> bus_write
}

void start_capture(void) {
  bus_write(ARDUCHIP_FIFO, FIFO_START_MASK); // write_reg funct --> bus_write
}

void clear_fifo_flag(void) { bus_write(ARDUCHIP_TRIG, CAP_DONE_MASK); }

void ArduCam_Init_YCbCr(void) {
  int terminal_debug = 1; // use for debugging

  GPIO_InitTypeDef GPIO_InitStruct = {0};

  // Configure the pin (e.g., PA5)
  GPIO_InitStruct.Pin = CS_PIN;
  GPIO_InitStruct.Mode = GPIO_MODE_OUTPUT_PP;
  GPIO_InitStruct.Pull = GPIO_NOPULL;
  GPIO_InitStruct.Speed = GPIO_SPEED_FREQ_LOW;
  HAL_GPIO_Init(CS_PORT, &GPIO_InitStruct);

  if (terminal_debug)
    printf("\r\nbeginning\r\n");
  uint8_t vid, pid;
  uint8_t temp = 0;

  bus_write(0x07, 0x80); // in arduino code for some reason
  HAL_Delay(100);
  bus_write(0x07, 0x00);
  HAL_Delay(100);

  // example driver code had these tests
  while (1) {
    bus_write(ARDUCHIP_TEST1, 0x55);
    temp = bus_read(ARDUCHIP_TEST1);
    printf("temp: %02X\r\n", temp);
    if (temp == 0x55) {
      if (terminal_debug)
        printf("\r\nSPI is ready\r\n");
      break;
    } else {
      if (terminal_debug)
        printf("\r\nSPI communication error\r\n");
    }
    HAL_Delay(1000);
  }
  while (1) {

    rdSensorReg16_8(OV5642_CHIPID_HIGH, &vid);
    rdSensorReg16_8(OV5642_CHIPID_LOW, &pid);
    if ((vid == 0x56) && (pid == 0x42)) {
      if (terminal_debug)
        printf("\r\nACK CMD OV5642 detected.\r\n");
      break;
    } else {
      if (terminal_debug)
        printf("\r\nACK CMD Can't find OV5642 module!\r\n");
    }
    HAL_Delay(1000);
  }

  // figuring out how to output ycbcr instead of jpeg was difficult
  // due to there being no non-jpeg exampels and the application
  // notes not being clear
  wrSensorReg16_8(0x3008, 0x80);
  HAL_Delay(100);
  wrSensorRegs16_8(OV5642_QVGA_Preview);
  HAL_Delay(100);

  bus_write(ARDUCHIP_TIM, VSYNC_LEVEL_MASK);
}

void convert_24(
    uint8_t Y, uint8_t Cb, uint8_t Cr,
    uint8_t array[3]) { // compiler is not mad when pass in uint8_t array[3]

  float R, G, B;
  float Yf = (float)Y;
  float Cbf = (float)Cb;
  float Crf = (float)Cr;

  // from OV5642 application notes
  R = Yf + 1.371 * (Crf - 128);
  G = Yf - 0.698 * (Crf - 128) - 0.336 * (Cbf - 128);
  B = Yf + 1.732 * (Cbf - 128);

  // color conversion chart says to clip
  if (R < 0)
    R = 0;
  if (R > 255)
    R = 255;
  if (G < 0)
    G = 0;
  if (G > 255)
    G = 255;
  if (B < 0)
    B = 0;
  if (B > 255)
    B = 255;

  array[0] = (uint8_t)R;
  array[1] = (uint8_t)G;
  array[2] = (uint8_t)B;
}

void SingleCapTransfer_YCbCr(
    int debug_terminal, int debug_python,
    uint8_t *camera_buf) { // passing in camera_buf[rgb888_data_length] makes
                           // compiler mad
  uint8_t temp[4];
  uint8_t first_8_yuyv_values[8];
  uint16_t first_8_rgb_values[8] = {
      0, 0, 0, 0, 0, 0, 0, 0}; // unnecessary but vestigial from debugging
  uint8_t rgb_24_vals_1[3];
  uint8_t rgb_24_vals_2[3];

  flush_fifo();
  clear_fifo_flag();
  start_capture();
  if (debug_terminal)
    printf("\r\n before while \r\n"); // debugging
  while (!get_bit(ARDUCHIP_TRIG, CAP_DONE_MASK)) {
    HAL_Delay(1000);
  }
  if (debug_terminal)
    printf("\r\n after while \r\n"); // debugging
  HAL_Delay(5);
  HAL_Delay(750);

  uint32_t length =
      320 * 240 * 2; // yuyv is a x2 multiplier, 4 bytes create 2 rgb pixels

  CS_LOW();
  // HAL_Delay(50);
  set_fifo_burst();
  // HAL_Delay(50);

  // debugging
  uint8_t start_flag[] = "START\n";
  if (debug_python)
    HAL_UART_Transmit(&hlpuart1, start_flag, sizeof(start_flag) - 1,
                      HAL_MAX_DELAY);

  uint8_t y0, y1, cb, cr;
  for (uint32_t i = 0; i + 4 <= length; i += 4) {
    HAL_SPI_Receive(&hspi1, temp, 4, HAL_MAX_DELAY); // & removed bc buffer
    y0 = temp[0];
    cb = temp[1];
    y1 = temp[2];
    cr = temp[3];

    convert_24(y0, cb, cr, rgb_24_vals_1);
    convert_24(y1, cb, cr, rgb_24_vals_2);

    int camera_index = (i * 3) / 2;

    // for some reason the image was coming out rotated 180 degrees
    // this code rotates it to be correct
    int index;
    int sign;
    if (1) {
      index = rgb888_data_length - 1;
      sign = -1;
    } else {
      index = 0;
      sign = 1;
    }

    camera_buf[index + sign * (camera_index)] =
        rgb_24_vals_1[2]; // do 012 if no flip, 210 if flip
    camera_buf[index + sign * (camera_index + 1)] = rgb_24_vals_1[1];
    camera_buf[index + sign * (camera_index + 2)] = rgb_24_vals_1[0];
    camera_buf[index + sign * (camera_index + 3)] = rgb_24_vals_2[2];
    camera_buf[index + sign * (camera_index + 4)] = rgb_24_vals_2[1];
    camera_buf[index + sign * (camera_index + 5)] = rgb_24_vals_2[0];

    /******/
    // DEBUGGING
    /******/
    if (debug_python)
      HAL_UART_Transmit(&hlpuart1, rgb_24_vals_1, 3,
                        HAL_MAX_DELAY); // debugging
    if (debug_python)
      HAL_UART_Transmit(&hlpuart1, rgb_24_vals_2, 3, HAL_MAX_DELAY);
    if (debug_terminal && 0)
      printf("\r\n%lx\r\n", i); // old debugging statement
    if (i <= 4) {
      first_8_yuyv_values[i] = temp[0];
      first_8_yuyv_values[i + 1] = temp[1];
      first_8_yuyv_values[i + 2] = temp[2];
      first_8_yuyv_values[i + 3] = temp[3];
    }
    if (i == 0) {
      if (debug_terminal)
        printf("\r\n%x, %x, %x\r\n", rgb_24_vals_1[0], rgb_24_vals_1[1],
               rgb_24_vals_1[2]);
      if (debug_terminal)
        printf("\r\n%x, %x, %x\r\n", rgb_24_vals_2[0], rgb_24_vals_2[1],
               rgb_24_vals_2[2]);
      first_8_rgb_values[i] = rgb_24_vals_1[0];
      first_8_rgb_values[i + 1] = rgb_24_vals_1[1];
      first_8_rgb_values[i + 2] = rgb_24_vals_1[2];
      first_8_rgb_values[i + 3] = rgb_24_vals_2[0];
      first_8_rgb_values[i + 4] = rgb_24_vals_2[1];
      first_8_rgb_values[i + 5] = rgb_24_vals_2[2];
    }
  }

  CS_HIGH();

  /******/
  // DEBUGGING
  /******/

  uint8_t end_flag[] = "END\n";
  if (debug_python)
    HAL_UART_Transmit(&hlpuart1, end_flag, sizeof(end_flag) - 1,
                      HAL_MAX_DELAY); // avoid null terminator
  if (debug_python)
    HAL_UART_Transmit(&hlpuart1, first_8_yuyv_values, 8, HAL_MAX_DELAY);
  uint8_t rgb_vals_8bit[16] = {0};
  for (int i = 0; i < 8; i++) {
    // send first 6 rgb values, doesn't fill full 8 bc I had a prior rgb565
    // setup that worked with 8 first 8 was uint16_t back when was using rgb565
    // which was uint16_t, uart can only send 1 byte at a time, so i split up
    // into higher and lower, vestigial debugging structure
    rgb_vals_8bit[0] = first_8_rgb_values[0]; // rgb_24_vals_1[0];
    rgb_vals_8bit[1] = first_8_rgb_values[1]; // rgb_24_vals_1[1];
    rgb_vals_8bit[2] = first_8_rgb_values[2]; // rgb_24_vals_1[2];
    rgb_vals_8bit[3] = first_8_rgb_values[3]; // rgb_24_vals_2[0];
    rgb_vals_8bit[4] = first_8_rgb_values[4]; // rgb_24_vals_2[1];
    rgb_vals_8bit[5] = first_8_rgb_values[5]; // rgb_24_vals_2[2];
  }
  if (debug_python)
    HAL_UART_Transmit(&hlpuart1, rgb_vals_8bit, 16, HAL_MAX_DELAY);
  if (debug_terminal)
    printf("\r\nend\r\n");
}
